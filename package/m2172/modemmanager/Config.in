## package/m2172/modemmanager/Config.in
```kconfig
menu "Configuration"
	depends on PACKAGE_modemmanager

config MODEMMANAGER_WITH_NETIFD
	bool "Include netifd support"
	default y

config MODEMMANAGER_WITH_MBIM
	bool "Include MBIM support"
	default n

config MODEMMANAGER_WITH_QMI
	bool "Include QMI support"
	default y

config MODEMMANAGER_WITH_QRTR
	bool "Include QRTR support"
	default y
	depends on MODEMMANAGER_WITH_QMI
	select LIBQMI_WITH_QRTR_GLIB

config MODEMMANAGER_WITH_AT_COMMAND_VIA_DBUS
	bool "Allow AT commands via D-Bus"
	default n

endmenu
```
